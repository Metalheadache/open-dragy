## examples/esp32/main/Kconfig.projbuild
```kconfig
# SPDX-License-Identifier: MPL-2.0
# Copyright 2026 Yizhan Wu
menu "Dragy engineering reference"
config REFERENCE_PEER_ADDRESS
    string "Selected Dragy BLE address (empty = scan and list only)"
    default ""
config REFERENCE_PEER_RANDOM
    bool "Selected address is a random BLE address"
    default n
config REFERENCE_REQUEST_25HZ
    bool "Request temporary 25 Hz on supported receiver profiles"
    default n
config REFERENCE_PROVISIONAL_RECEIVERS
    bool "Enable provisional DRG70 / DRG70-C / Lite rate requests"
    depends on REFERENCE_REQUEST_25HZ
    default n
    help
        Experimental common-interface assumption; these models are not hardware
        validated by this reference. A recognized DRG69 model blocks the request.
config REFERENCE_ARM_TESTS
    bool "Explicitly arm experimental drag detectors after boot"
    default n
endmenu
```

## examples/esp32/sdkconfig.defaults
```kconfig
# SPDX-License-Identifier: MPL-2.0
# Copyright 2026 Yizhan Wu
CONFIG_BT_ENABLED=y
CONFIG_BT_NIMBLE_ENABLED=y
CONFIG_BT_NIMBLE_ROLE_CENTRAL=y
CONFIG_BT_NIMBLE_ROLE_OBSERVER=y
CONFIG_BT_NIMBLE_MAX_CONNECTIONS=1
CONFIG_BT_NIMBLE_ATT_PREFERRED_MTU=247
CONFIG_BT_NIMBLE_HOST_TASK_STACK_SIZE=6144
CONFIG_COMPILER_CXX_EXCEPTIONS=n
CONFIG_ESP_MAIN_TASK_STACK_SIZE=4096
```
